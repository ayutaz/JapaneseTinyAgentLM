## firmware/jtalm_action/main/Kconfig.projbuild
```kconfig
# SPDX-License-Identifier: Apache-2.0
# Copyright 2026 ayutaz
menu "JapaneseTinyAgentLM"

config JTALM_GATE_PPM
    int "Confidence gate threshold (x 1/1000000)"
    range 0 1000000
    default 836730
    help
        An output whose minimum token probability (unconstrained, as in
        jtalm.model.decode) is below this threshold becomes "[]", as the
        "gate" mode of jtalm.model.evaluate. 0 turns the gate off.
        It can be changed at run time with "!gate <threshold>".

endmenu
```

## runtime/host/Kconfig
```kconfig
# SPDX-License-Identifier: Apache-2.0
# Copyright 2026 ayutaz
menu "JapaneseTinyAgentLM runtime"

config JTLM_KV_INT8
    bool "INT8 KV cache"
    default n
    help
        Keep the KV cache in int8 with one f32 scale per position and KV
        head (about 0.28x the bytes of the f32 cache). It changes the
        numerics: outputs can differ from the default f32 cache (see
        runtime/host/README.md). The PyTorch reference is
        jtalm.model.transformer.set_kv_int8.

endmenu
```
